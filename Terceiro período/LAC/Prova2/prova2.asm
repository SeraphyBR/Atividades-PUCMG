;************** AULA 01 - PROVA *************
LIST   P=PIC16F628A
RADIX DEC 
#INCLUDE <P16F628A.INC>
 __CONFIG H'3F10'

 CBLOCK 0x20 ;ENDEREÇO INICIAL DA MEMÓRIA DE
     ;USUÁRIO
 CONTADOR1
 CONTADOR2
 CONTADOR3
 CONTADOR4
 ENDC   ;FIM DO BLOCO DE MEMÓRIA  
 
 ORG 0x00  ;ENDEREÇO INICIAL DE PROCESSAMENTO
 GOTO INICIO
  
INICIO
 CLRF PORTA  ;LIMPA O PORTA
 CLRF PORTB  ;LIMPA O PORTB
 BSF STATUS, RP0
 CLRF TRISB
 BCF STATUS, RP0

REPETE
 BSF PORTB, 1
 CALL ATRASO
 BCF PORTB, 1
 CALL ATRASO
 GOTO REPETE


ATRASO    
 MOVLW 162
 MOVWF CONTADOR1 
ATRASO1 
 MOVLW 162
 MOVWF CONTADOR2 
ATRASO2
 MOVLW 159
 MOVWF CONTADOR3
ATRASO3
 DECFSZ CONTADOR3
 GOTO ATRASO3
 DECFSZ CONTADOR2
 GOTO ATRASO2
 DECFSZ CONTADOR1
 GOTO ATRASO1
 CALL OFFSET      
 RETURN 
 
OFFSET
 MOVLW 5
 MOVWF CONTADOR4
ATRASO4
 DECFSZ CONTADOR4
 GOTO ATRASO4
 RETURN
    
END

